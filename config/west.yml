## config/west.yml
```yaml
manifest:
  remotes:
    - name: zmkfirmware
      url-base: https://github.com/zmkfirmware
    - name: lizard-5x12-nicenano
      url-base: https://github.com/jonbobcar
    # Additional modules containing boards/shields/custom code can be listed here as well
    # See https://docs.zephyrproject.org/3.2.0/develop/west/manifest.html#projects
  projects:
    - name: zmk
      remote: zmkfirmware
      revision: main
      import: app/west.yml
    - name: lizard-5x12-nicenano
      remote: lizard-5x12-nicenano
      revision: main
  self:
    path: config
```
